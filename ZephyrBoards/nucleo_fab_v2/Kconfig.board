## ZephyrBoards/nucleo_fab_v2/Kconfig.board
```kconfig
# STM32F767ZI Nucleo board configuration

# Copyright (c) 2019 Roland Ma
# SPDX-License-Identifier: Apache-2.0

config BOARD_NUCLEO_F767ZI_BY_FABIAN_V2
	bool "Nucleo F767ZI Development Board by Fabian version 2"
	depends on SOC_STM32F767XX
```

## ZephyrBoards/nucleo_fab_v2/Kconfig.defconfig
```kconfig
# STM32F767ZI Nucleo board configuration

# Copyright (c) 2019 Roland Ma
# SPDX-License-Identifier: Apache-2.0

if BOARD_NUCLEO_F767ZI_BY_FABIAN_V2

config BOARD
	default "nucleo_fab_v2"

if NETWORKING

config NET_L2_ETHERNET
	default y

config ETH_STM32_HAL
	default y

endif # NETWORKING

endif # BOARD_NUCLEO_F767ZI
```

## ZephyrBoards/nucleo_fabian/Kconfig.board
```kconfig
# STM32F767ZI Nucleo board configuration

# Copyright (c) 2019 Roland Ma
# SPDX-License-Identifier: Apache-2.0

config BOARD_NUCLEO_F767ZI_BY_FABIAN
	bool "Nucleo F767ZI Development Board by Fabian"
	depends on SOC_STM32F767XX
```

## ZephyrBoards/nucleo_fabian/Kconfig.defconfig
```kconfig
# STM32F767ZI Nucleo board configuration

# Copyright (c) 2019 Roland Ma
# SPDX-License-Identifier: Apache-2.0

if BOARD_NUCLEO_F767ZI_BY_FABIAN

config BOARD
	default "nucleo_fabian"

if NETWORKING

config NET_L2_ETHERNET
	default y

config ETH_STM32_HAL
	default y

endif # NETWORKING

endif # BOARD_NUCLEO_F767ZI
```

## Zephyr_OS/BlinkingLED/sample.yaml
```yaml
sample:
	name: Blinky sample
tests:
	sample.basic.BlinkingLED:
		tags: LED GPIO
		filter: dt_compat_enabled_with_alias("gpio-leds", "led0")
		depends_on: gpio
		harness: led
```
